## main/Kconfig.projbuild
```kconfig
menu "Neurodaq Configuration"

    config ESP_WIFI_SSID
        string "WiFi SSID"
        default "myssid"
        help
            SSID (network name) for the example to connect to.

    config ESP_WIFI_PASSWORD
        string "WiFi Password"
        default "mypassword"
        help
            WiFi password (WPA or WPA2) for the example to use.

    choice ESP_WIFI_SAE_MODE
        prompt "WPA3 SAE mode selection"
        default ESP_STATION_EXAMPLE_WPA3_SAE_PWE_BOTH
        help
            Select mode for SAE as Hunt and Peck, H2E or both.
        config ESP_STATION_EXAMPLE_WPA3_SAE_PWE_HUNT_AND_PECK
            bool "HUNT AND PECK"
        config ESP_STATION_EXAMPLE_WPA3_SAE_PWE_HASH_TO_ELEMENT
            bool "H2E"
            depends on ESP_WIFI_ENABLE_SAE_H2E
        config ESP_STATION_EXAMPLE_WPA3_SAE_PWE_BOTH
            bool "BOTH"
            depends on ESP_WIFI_ENABLE_SAE_H2E
    endchoice

    config ESP_WIFI_PW_ID
        string "PASSWORD IDENTIFIER"
        depends on  ESP_STATION_EXAMPLE_WPA3_SAE_PWE_HASH_TO_ELEMENT|| ESP_STATION_EXAMPLE_WPA3_SAE_PWE_BOTH
        default ""
        help
            password identifier for SAE H2E

    config ESP_MAXIMUM_RETRY
        int "Maximum retry"
        default 5
        help
            Set the Maximum retry to avoid station reconnecting to the AP unlimited when the AP is really inexistent.

    choice ESP_WIFI_SCAN_AUTH_MODE_THRESHOLD
        prompt "WiFi Scan auth mode threshold"
        default ESP_WIFI_AUTH_WPA2_PSK
        help
            The weakest authmode to accept in the scan mode.
            This value defaults to ESP_WIFI_AUTH_WPA2_PSK in case password is present and ESP_WIFI_AUTH_OPEN is used.
            Please select ESP_WIFI_AUTH_WEP/ESP_WIFI_AUTH_WPA_PSK in case AP is operating in WEP/WPA mode.

        config ESP_WIFI_AUTH_OPEN
            bool "OPEN"
        config ESP_WIFI_AUTH_WEP
            bool "WEP"
        config ESP_WIFI_AUTH_WPA_PSK
            bool "WPA PSK"
        config ESP_WIFI_AUTH_WPA2_PSK
            bool "WPA2 PSK"
        config ESP_WIFI_AUTH_WPA_WPA2_PSK
            bool "WPA/WPA2 PSK"
        config ESP_WIFI_AUTH_WPA3_PSK
            bool "WPA3 PSK"
        config ESP_WIFI_AUTH_WPA2_WPA3_PSK
            bool "WPA2/WPA3 PSK"
        config ESP_WIFI_AUTH_WAPI_PSK
            bool "WAPI PSK"
    endchoice

    config ESP_UDP_IP
        string "UDP IP"
        default "192.168.1.57"
        help
            IP address for the UDP transport.


    config ESP_UDP_PORT
        int "UDP Port"
        range 0 65535
        default 3333
        help
            EEG Streamer Port (UDP)


    config ESP_TCP_PORT
        int "TCP Port"
        range 0 65535
        default 3334
        help
            Control Server Port (TCP)

    config ESP_TCP_TIMEOUT
            int "TCP Timeout"
            range 0 65535
            default 5
            help
                Control Server Port (TCP)


    menu "Task Core Affinity"

        config EEG_MANAGER_CORE
            int "EEGManager handler core"
            range 0 1
            default 1
            help
                Core for the EEGManager handler task.

        config DSP_CORE
            int "DSP core"
            range 0 1
            default 1
            help
                Core for the DSP task.

        config EDGE_ML_CORE
            int "Edge ML core"
            range 0 1
            default 0
            help
                Core for the Edge ML inference task.

        config EEG_STREAMER_CORE
            int "EEGStreamer core"
            range 0 1
            default 1
            help
                Core for the EEGStreamer task.

        config CONTROL_SERVER_CORE
            int "Control server core"
            range 0 1
            default 0
            help
                Core for the control server task.

    endmenu
endmenu
```
